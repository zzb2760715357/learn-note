/{
        DTS_demo {
                compatible = "DTS_demo";
                status = "okay";
        };
	DTS_demoX{
                compatible = "DTS_demoX";
		status = "disabled";
	};

	DTS_demoY {
                compatible = "DTS_demoY";
		status = "disabled";
	};

};
